## CMakeLists.txt
```
# SPDX-License-Identifier: Apache-2.0

cmake_minimum_required(VERSION 3.20.0)

if(NOT ("${OS}" STREQUAL "LINUX"))
    MESSAGE("search for zephyr")
    find_package(Zephyr REQUIRED HINTS $ENV{ZEPHYR_BASE})
endif()

project(nanochess)

if("${OS}" STREQUAL "LINUX")
    MESSAGE("plain linux")
    add_executable(app)
    target_compile_options(app PRIVATE -DCONFIG_ARCH_POSIX)
endif()

target_sources(app PRIVATE src/main.cpp src/chess-interface.cpp src/nano-chess.cpp)
```

## sample.yaml
```
sample:
  name: Nanochess for Zephyr
```

## prj.conf
```kconfig
CONFIG_MAIN_STACK_SIZE=8192
CONFIG_CONSOLE=y
CONFIG_CONSOLE_SUBSYS=y
CONFIG_CONSOLE_GETCHAR=y
CONFIG_CPP=y
CONFIG_LIB_CPLUSPLUS=y
```

## src/main.c
```c
/**************************************************************************\
| Toledo Nanochess (c) Copyright 2009 Oscar Toledo G. All rights reserved  |
| 1257 non-blank characters. Evolution from my winning IOCCC 2005 entry.   |
| o Use D2D4 algebraic style for movements.  biyubi@gmail.com  Nov/20/2009 |
| o On promotion add a number for final piece (3=N, 4=B, 5=R, 6=Q)         |
| o Press Enter alone for computer to play.                                |
| o Full legal chess moves.                       http://www.nanochess.org |
| o Remove these comments to get 1326 bytes source code (*NIX end-of-line) |
\**************************************************************************/

#include <stdbool.h>
#if defined(CONFIG_ARCH_POSIX)
	#include <stdio.h>
#else
	#include <zephyr/kernel.h>
	#include <zephyr/sys/printk.h>
	#include <zephyr/console/console.h>
#endif

#define MAX_LEVEL 5

const char* default_board =
	// initial board
	"ustvrtsu"
	"qqqqqqqq"
	"yyyyyyyy"
	"}{|~z|{}";

const char* ref =
	// points by piece
	"   76Ls"

	// points for center
	"abcddcba "

	// piece letters
	".pknbrq  PKNBRQ " /* no longer needed */

	// movements
	"?A6J57IKJT576,+-48HLSU";

const char* piece_letters = ".pknbrq  PKNBRQ ";
const char* movement_offsets = "& .$  ";
char origin_of_move;
char promote_to;
char can_en_passant;
char target_of_move;
char board[411];
char* best_enemy_move = board;
char actual_side = 0;

static inline void switch_sides() { actual_side ^= 8; }

int next(
	char recapture_square, char reset_enemy_score, char level,
	char initial_search_square, char pawn_for_en_passant, char max_level
) {
	char origin_square = initial_search_square;
	int net_score = -100000000;
	const int mate_score = (78 - level) << 10;
	char* rook_origin = NULL;
	const char pawn_direction = actual_side ? -10 : 10;
	switch_sides();
	best_enemy_move++;
	char in_check = recapture_square ||
		(max_level && max_level >= level && next(0, 0, 0, 21, 0, 0) > 10000);

	do {
		char target_square = origin_square;
		char original_content = board[(int) target_square];
		if (original_content) {
			char current_piece = (original_content & 0xf) ^ actual_side;
			if (current_piece < 7) {
				char limit_offset = current_piece-- & 2 ? 8 : 4;
				char movement_offset = (original_content - 9) & 0xf ?
					movement_offsets[(int) current_piece] : 42;

				char original_target_content;
				do {
					target_square += ref[(int) movement_offset] - 64;
					original_target_content = board[(int) target_square];
					if (!recapture_square | (target_square == recapture_square)) {
						char *tmp_square = current_piece |
							(target_square + pawn_direction - pawn_for_en_passant) ?
								0 : board + pawn_for_en_passant;

						if (!original_target_content & (current_piece | (limit_offset < 3) || tmp_square) || ((((original_target_content + 1) & 0xf) ^ actual_side) > 9 && current_piece | (limit_offset > 2))) {
							if (!((original_target_content - 2) & 7)) {
								--best_enemy_move;
								best_enemy_move[1] = origin_square;
								switch_sides();
								return mate_score;
							}
							char final_piece = original_content & 0xf;
							char cant_castle = final_piece;
							char before_pawn = board[target_square - pawn_direction] & 0xf;
							char limit_piece = current_piece | (before_pawn - 7) ? final_piece : (final_piece += 2, 6 ^ actual_side);
							while (final_piece <= limit_piece) {
								int score = original_target_content ? ref[original_target_content & 7] * 9 - 189 - level - current_piece : 0;
								if (max_level) {
									score += (
											 1 - current_piece ? ref[target_square / 10 + 5] - ref[origin_square / 10 + 5] + ref[target_square % 10 + 6] * (!current_piece ? 2 : 1) - ref[origin_square % 10 + 6] +
													 original_content / 16 * 8 : (rook_origin ? 1 : 0) * 9
										 ) + (
											 current_piece ? 0 : !(board[target_square - 1] ^ final_piece) + !(board[target_square + 1] ^ final_piece) + ref[final_piece & 7] * 9 - 386 + (tmp_square ? 1 : 0) * 99 +
													 (limit_offset < 2)
										 ) + !(before_pawn ^ actual_side ^ 9);
								}
								if (max_level > level || ((1 < max_level) & (max_level == level) && (score > 0xf) | in_check)) {
									board[(int) target_square] = final_piece;
									board[(int) origin_square] = rook_origin && tmp_square ? *tmp_square = *rook_origin, *rook_origin = 0 : tmp_square ? *tmp_square = 0 : 0;
									score -= next((max_level > level) | in_check ? 0 : target_square, score - net_score, level + 1, best_enemy_move[1], cant_castle = (current_piece | (limit_offset > 1)) ? 0 : target_square, max_level);
									if (!(
										level || (max_level - 1) | (origin_of_move - origin_square) | (promote_to - final_piece) | (target_square - target_of_move) | (score < -10000)
									)) {
										--best_enemy_move;
										switch_sides(); switch_sides();
										return can_en_passant = cant_castle;
									}
									cant_castle = (current_piece - 1) | (limit_offset < 7) || rook_origin || (!max_level) | in_check | original_target_content | (original_content < 0xf) || next(0, 0, 0, 21, 0, 0) > 10000;
									board[(int) origin_square] = original_content;
									board[(int) target_square] = original_target_content;
									if (rook_origin && tmp_square) {
										*rook_origin = *tmp_square;
										*tmp_square = 0;
									} else if (tmp_square) {
										*tmp_square = 9 ^ actual_side;
									}
								}
								if (score > net_score) {
									*best_enemy_move = origin_square;
									if (max_level > 1) {
										if (level && reset_enemy_score - score < 0) {
											switch_sides();
											--best_enemy_move;
											return score;
										}
										if (!level) {
											promote_to = final_piece;
											origin_of_move = origin_square;
											target_of_move = target_square;
										}
									}
									net_score = score;
								}
								final_piece += cant_castle || (tmp_square = board + target_square, rook_origin = target_square < origin_square ? tmp_square - 3 : tmp_square + 2, (*rook_origin < 0xf) | rook_origin[(int) (origin_square - target_square)] || board[(int) (target_square += target_square - origin_square)]);
							}
						}
					}
				} while (
					!original_target_content & (current_piece > 2) || (
						target_square = origin_square, current_piece | (limit_offset > 2) | (
							(original_content > 0xf) & !original_target_content
						) && ++movement_offset && --limit_offset
					)
				);
			}
		}
	} while (++origin_square > 98 ? (origin_square = 20) : initial_search_square - origin_square);
	--best_enemy_move;
	switch_sides();
	return net_score + 100000000 && (net_score > -mate_score + 1924) | in_check ? net_score : 0;
}

int my_getc() {
	#if defined(CONFIG_ARCH_POSIX)
		return getchar();
	#else
		for (;;) {
			int got = console_getchar();
			if (got) {
				printk("%c", got);
				if (got == 0x0d) { printk("\x0a"); got = 0x0a; }
				return got;
			}
		}
	#endif
}

void my_putc(char ch) {
	#if defined(CONFIG_ARCH_POSIX)
		putchar(ch);
	#else
		printk("%c", ch);
	#endif
}

void my_puts(const char* s) {
	while (*s) { my_putc(*s++); }
}

static inline char next_default_piece(int offset) {
	if (offset / 10 % 10 < 2 || offset % 10 < 2) { return 7; }
	if (offset / 10 & 4) { return 0; }
	return *default_board++ & 31;
}

static inline void setup_board() {
	origin_of_move = 0;
	while (++origin_of_move < 121) {
		*best_enemy_move++ = next_default_piece(origin_of_move);
	}
}

static inline void print_board() {
	int i = 19;
	while (i++ < 99) {
		if (i % 10) {
			my_putc(piece_letters[board[i] & ~16]);
		} else { my_putc('\n'); }
	}
}

static inline void read_promotion_piece() {
	promote_to = board[(int) origin_of_move] & 0xf;
	for (;;) {
		char ch = my_getc() & 0xf;
		if (ch == '\n') { break; }
		promote_to = ch ^ 8 ^ actual_side;
	}
}

void print_position(int pos) {
	my_putc(pos % 10 + 'A' - 1); my_putc(10 - pos / 10 + '0');
}

int main() {
	#if !defined(CONFIG_ARCH_POSIX)
		console_init();
	#endif
	setup_board();
	for (;;) {
		print_board();

		origin_of_move = my_getc() & 0xf;
		if (origin_of_move != '\n') {
			origin_of_move += ((10 - my_getc()) & 0xf) * 10;
			target_of_move = my_getc() & 0xf;
			target_of_move += ((10 - my_getc()) & 0xf) * 10;
			read_promotion_piece();
			my_puts("\nperform move ");
			print_position(origin_of_move);
			print_position(target_of_move);
			my_putc('\n');
		} else {
			my_puts("\nperform computer move\n");
			next(0, 0, 0, 21, can_en_passant, MAX_LEVEL);
		}
		next(0, 0, 0, 21, can_en_passant, 1);
	}
}
```

## src/main.cpp
```c
#include "nano-chess.h"

#if defined(CONFIG_ARCH_POSIX)
	#include <cstdio>
#else
	#include <zephyr/kernel.h>
	#include <zephyr/sys/printk.h>
	#include <zephyr/console/console.h>
#endif

char get_char() {
	#if defined(CONFIG_ARCH_POSIX)
		return static_cast<char>(getchar());
	#else
		for (;;) {
			int got = console_getchar();
			if (got) {
				printk("%c", got);
				if (got == 0x0d) { printk("\x0a"); got = 0x0a; }
				return static_cast<char>(got);
			}
		}
	#endif
}

void print_prompt() { put_string("\n> "); }
void input_error(const char* reason) {
	put_string(reason);
	put_string(", try again");
	print_prompt();
}

void main_loop [[noreturn]] () {
	Mek::Chess::Nano_Chess engine;
	engine.reset_board(); print_prompt();
	char line[16];
	const char* line_end { line + sizeof(line)/sizeof(*line) - 1 };

	for (;;) {
		char* line_cur = line;
		for (;;) {
			char got { get_char() };
			if (got == '\n') { break; }
			if (got <= ' ') { continue; }
			if (line_cur == line_end) {
				while (get_char() != '\n') { }
				line_cur = line;
				input_error("line too long"); continue;
			}
			*line_cur++ = got;
		}
		if (line_cur == line) {
			engine.move(engine.compute_move()); print_prompt();
			continue;
		}
		if (line_cur - line < 5) { input_error("missing move or piece"); continue; }

		Mek::Chess::Position from_pos { line };
		Mek::Chess::Position to_pos { line + 2 };
		auto piece { Mek::Chess::piece_from_ch(line[4]) };
		if (!from_pos) { input_error("from position not valid"); continue; }
		if (!to_pos) { input_error("to position not valid"); continue; }
		if (piece == Mek::Chess::Piece::none) { input_error("piece not valid"); continue; }

		Mek::Chess::Piece promote_to { Mek::Chess::Piece::none };

		auto cur { line + 5};
		if (cur < line_cur && *cur == '!') {
			++cur;
			if (cur >= line_cur) { put_string("missing promote piece"); continue; }
			promote_to = Mek::Chess::piece_from_ch(*cur++);
			if (promote_to == Mek::Chess::Piece::none) {
				input_error("invalid promote piece"); continue;
			}
		}

		Mek::Chess::Piece captured { Mek::Chess::Piece::none };
		const char* captured_position { nullptr };
		if (cur < line_cur && *cur == 'x') {
			++cur;
			if (cur >= line_cur) { put_string("missing captured piece"); continue; }
			captured = Mek::Chess::piece_from_ch(*cur++);
			if (captured == Mek::Chess::Piece::none) {
				input_error("invalid captured piece"); continue;
			}
			if (cur < line_cur) {
				if (cur + 1 >= line_cur) {
					put_string("incomplete captured position"); continue;
				}
				captured_position = cur;
				cur += 2;
			}
		}

		if (cur != line_cur) {
			put_string("unexpected characters in input line"); continue;
		}

		if (captured != Mek::Chess::Piece::none) {
			if (captured_position) {
				engine.move(Mek::Chess::Move {
					from_pos, to_pos, piece, promote_to, captured, Mek::Chess::Position { captured_position }
				});
			} else {
				engine.move(Mek::Chess::Move { from_pos, to_pos, piece, promote_to, captured, to_pos });
			}
		} else {
			engine.move(Mek::Chess::Move { from_pos, to_pos, piece, promote_to });
		}
		print_prompt();
	}
}

int main() {
	#if !defined(CONFIG_ARCH_POSIX)
		console_init();
	#endif
	main_loop();
}
```

## src/chess-interface.cpp
```c
#include "chess-interface.h"

using namespace Mek::Chess;

Piece Mek::Chess::piece_from_ch(char ch) {
	switch (ch) {
		case 'k': case 'K': return Piece::king;
		case 'q': case 'Q': return Piece::queen;
		case 'b': case 'B': return Piece::bishop;
		case 'n': case 'N': return Piece::knight;
		case 'r': case 'R': return Piece::rook;
		case 'p': case 'P': return Piece::pawn;
		default: return Piece::none;
	}
}
```

## src/chess-interface.h
```c
#if !defined (MekChessInterface_h)
	#define MekChessInterface_h

	#include <cassert>

	namespace Mek::Chess {
		enum class Piece : char {
			king = 'k', queen = 'q', bishop = 'b', knight = 'n',
			rook = 'r', pawn = 'p', none [[maybe_unused]] = ' '
		};

		Piece piece_from_ch(char ch);

		struct Position {
			static unsigned char valid_num(int num) {
				assert(num >= 0); assert(num <= 8);
				return static_cast<unsigned char>(num & 0xf);
			}

			explicit Position(int col = 0, int row = 0):
				col { valid_num(col) }, row { valid_num(row) }
			{ }

			static unsigned char col_from_ch(char ch) {
				if (ch >= 'a' && ch <= 'h') { return ch + 1 - 'a'; }
				if (ch >= 'A' && ch <= 'H') { return ch + 1 - 'A'; }
				return 0;
			}

			static unsigned char row_from_ch(char ch) {
				if (ch >= '1' && ch <= '8') { return ch - '0'; }
				return 0;
			}

			explicit Position(const char* str):
				Position { col_from_ch(str[0]), row_from_ch(str[1]) }
			{ }

			const unsigned char col: 4;
			const unsigned char row: 4;

			explicit operator bool() const { return col > 0 && row > 0; }

			[[nodiscard]] char col_ch() const {
				return static_cast<char>(col + '0');
			}

			[[nodiscard]] char row_ch() const {
				return static_cast<char>(row + '0');
			}
		};

		inline bool operator==(const Position& a, const Position& b) {
			return (!a && !b) || (a.col == b.col && a.row == b.row);
		}

		inline bool operator!=(const Position& a, const Position& b) { return !(a == b); }

		static_assert(sizeof(Position) == 1);

		struct Move {
			Move(
				Position from, Position to, Piece piece, Piece promoted = Piece::none,
				Piece captured = Piece::none, Position captured_position = Position {}
			):
				from { from }, to { to }, piece { piece }, promoted { promoted },
				captured { captured }, captured_position { captured_position }
			{ assert(from); assert(to); assert(piece != Piece::none); }

			const Position from;
			const Position to;
			const Piece piece;
			const Piece promoted;
			const Piece captured;
			const Position captured_position;
		};

		class Engine {
			public:
				virtual ~Engine() = default;

				virtual void reset_board() = 0;
				virtual void move(const Move& move) = 0;
				virtual Move compute_move() = 0;
		};
	}

#endif
```

## src/nano-chess.cpp
```c
#include "nano-chess.h"

/**************************************************************************\
| Toledo Nanochess (c) Copyright 2009 Oscar Toledo G. All rights reserved  |
| 1257 non-blank characters. Evolution from my winning IOCCC 2005 entry.   |
| o Use D2D4 algebraic style for movements.  biyubi@gmail.com  Nov/20/2009 |
| o On promotion add a number for final piece (3=N, 4=B, 5=R, 6=Q)         |
| o Press Enter alone for computer to play.                                |
| o Full legal chess moves.                       http://www.nanochess.org |
| o Remove these comments to get 1326 bytes source code (*NIX end-of-line) |
\**************************************************************************/

#if defined(CONFIG_ARCH_POSIX)
	#include <cstdio>
#else
	#include <zephyr/kernel.h>
	#include <zephyr/sys/printk.h>
	#include <zephyr/console/console.h>
#endif

using namespace Mek::Chess;

namespace {
	#define MAX_LEVEL 5

	const char* orig_default_board =
		// initial board
		"ustvrtsu"
		"qqqqqqqq"
		"yyyyyyyy"
		"}{|~z|{}";

	const char* default_board = orig_default_board;

	const char* ref =
		// points by piece
		"   76Ls"

		// points for center
		"abcddcba "

		// piece letters
		".pknbrq  PKNBRQ " /* no longer needed */

		// movements
		"?A6J57IKJT576,+-48HLSU";

	const char* piece_letters = ".pknbrq  PKNBRQ ";
	const char* movement_offsets = "& .$  ";
	char origin_of_move;
	char promote_to;
	char can_en_passant;
	char target_of_move;
	char board[411];
	char* best_enemy_move = board;
	char actual_side = 0;

	inline void switch_sides() { actual_side ^= 8; }

	int next(
		char recapture_square, int reset_enemy_score, char level,
		char initial_search_square, char pawn_for_en_passant, char max_level
	) {
		char origin_square = initial_search_square;
		int net_score = -100000000;
		const int mate_score = (78 - level) << 10;
		char* rook_origin = nullptr;
		const char pawn_direction = actual_side ? -10 : 10;
		switch_sides();
		best_enemy_move++;
		char in_check = static_cast<char>(
			recapture_square || (
				max_level && max_level >= level &&
				next(0, 0, 0, 21, 0, 0) > 10000
			)
		);

		do {
			char target_square = origin_square;
			char original_content = board[
				static_cast<unsigned char>(target_square)
			];
			if (original_content) {
				char current_piece = static_cast<char>(
					(original_content & 0xf) ^ actual_side
				);
				if (current_piece < 7) {
					char limit_offset = current_piece-- & 2 ? 8 : 4;
					char movement_offset = static_cast<char>(
						(original_content - 9) & 0xf ?
							movement_offsets[
								static_cast<unsigned char>(current_piece)
							] :
							42
					);

					char original_target_content;
					do {
						target_square = static_cast<char>(
							target_square +
							ref[static_cast<unsigned char>(movement_offset)] -
							64
						);
						original_target_content = board[
							static_cast<unsigned char>(target_square)
						];
						if (!recapture_square | (target_square == recapture_square)) {
							char *tmp_square = current_piece |
											   (target_square + pawn_direction - pawn_for_en_passant) ?
								nullptr : board + pawn_for_en_passant;

							if (!original_target_content & (current_piece | (limit_offset < 3) || tmp_square) || ((((original_target_content + 1) & 0xf) ^ actual_side) > 9 && current_piece | (limit_offset > 2))) {
								if (!((original_target_content - 2) & 7)) {
									--best_enemy_move;
									best_enemy_move[1] = origin_square;
									switch_sides();
									return mate_score;
								}
								char final_piece = static_cast<char>(original_content & 0xf);
								char cant_castle = final_piece;
								char before_pawn = static_cast<char>(board[target_square - pawn_direction] & 0xf);
								char limit_piece = static_cast<char>(
									current_piece | (before_pawn - 7) ?
										final_piece :
										(final_piece += 2, 6 ^ actual_side)
								);
								while (final_piece <= limit_piece) {
									int score = original_target_content ? ref[original_target_content & 7] * 9 - 189 - level - current_piece : 0;
									if (max_level) {
										score += (
													 1 - current_piece ? ref[target_square / 10 + 5] - ref[origin_square / 10 + 5] + ref[target_square % 10 + 6] * (!current_piece ? 2 : 1) - ref[origin_square % 10 + 6] +
																		 original_content / 16 * 8 : (rook_origin ? 1 : 0) * 9
												 ) + (
													 current_piece ? 0 : !(board[target_square - 1] ^ final_piece) + !(board[target_square + 1] ^ final_piece) + ref[final_piece & 7] * 9 - 386 + (tmp_square ? 1 : 0) * 99 +
																		 (limit_offset < 2)
												 ) + !(before_pawn ^ actual_side ^ 9);
									}
									if (max_level > level || ((1 < max_level) & (max_level == level) && (score > 0xf) | in_check)) {
										board[static_cast<unsigned char>(target_square)] = final_piece;
										board[static_cast<unsigned char>(origin_square)] = static_cast<char>(
											rook_origin && tmp_square ?
												*tmp_square = *rook_origin, *rook_origin = 0 :
												tmp_square ? *tmp_square = 0 : 0
										);
										score -= next(
											static_cast<char>((max_level > level) | in_check ? 0 : target_square),
											score - net_score,
											static_cast<char>(level + 1),
											best_enemy_move[1],
											cant_castle = static_cast<char>(
												(current_piece | (limit_offset > 1)) ? 0 : target_square
											),
											max_level
										);
										if (!(
											level || (max_level - 1) | (origin_of_move - origin_square) | (promote_to - final_piece) | (target_square - target_of_move) | (score < -10000)
										)) {
											--best_enemy_move;
											switch_sides();
											switch_sides();
											return can_en_passant = cant_castle;
										}
										cant_castle = static_cast<char>((current_piece - 1) | (limit_offset < 7) || rook_origin || (!max_level) | in_check | original_target_content | (original_content < 0xf) || next(0, 0, 0, 21, 0, 0) > 10000);
										board[static_cast<unsigned char>(origin_square)] = original_content;
										board[static_cast<unsigned char>(target_square)] = original_target_content;
										if (rook_origin && tmp_square) {
											*rook_origin = *tmp_square;
											*tmp_square = 0;
										} else if (tmp_square) {
											*tmp_square = static_cast<char>(9 ^ actual_side);
										}
									}
									if (score > net_score) {
										*best_enemy_move = origin_square;
										if (max_level > 1) {
											if (level && reset_enemy_score - score < 0) {
												switch_sides();
												--best_enemy_move;
												return score;
											}
											if (!level) {
												promote_to = final_piece;
												origin_of_move = origin_square;
												target_of_move = target_square;
											}
										}
										net_score = score;
									}
									final_piece = static_cast<char>(final_piece + (cant_castle || (tmp_square = board + target_square, rook_origin = target_square < origin_square ? tmp_square - 3 : tmp_square + 2, (*rook_origin < 0xf) | rook_origin[(int) (origin_square - target_square)] || board[static_cast<unsigned char>(target_square = static_cast<char>(2 * target_square - origin_square))])));
								}
							}
						}
					} while (
						!original_target_content & (current_piece > 2) || (
							target_square = origin_square, current_piece | (limit_offset > 2) | (
								(original_content > 0xf) & !original_target_content
							) && ++movement_offset && --limit_offset
						)
						);
				}
			}
		} while (++origin_square > 98 ? (origin_square = 20) : initial_search_square - origin_square);
		--best_enemy_move;
		switch_sides();
		return net_score + 100000000 && (net_score > -mate_score + 1924) | in_check ? net_score : 0;
	}

	inline char next_default_piece(int offset) {
		if (offset / 10 % 10 < 2 || offset % 10 < 2) { return 7; }
		if (offset / 10 & 4) { return 0; }
		return static_cast<char>(*default_board++ & 31);
	}

	inline void setup_board() {
		default_board = orig_default_board;
		best_enemy_move = board;
		origin_of_move = 0;
		while (++origin_of_move < 121) {
			*best_enemy_move++ = next_default_piece(origin_of_move);
		}
	}

	void put_char(int ch) {
		#if defined(CONFIG_ARCH_POSIX)
			putchar(ch);
		#else
			printk("%c", static_cast<char>(ch));
		#endif
	}

	inline void print_board() {
		int i = 19;
		while (i++ < 99) {
			if (i % 10) {
				put_char(piece_letters[board[i] & ~16]);
			} else { put_char('\n'); }
		}
	}

	void print_position(int pos) {
		put_char(pos % 10 + 'A' - 1);
		put_char(10 - pos / 10 + '0');
	}
}

void put_string(const char* s) { while (*s) { put_char(*s++); } }

void Nano_Chess::reset_board() { setup_board(); print_board(); }

char ch_from_position(const Position& pos) {
	return static_cast<char>(
		(pos.col_ch() & 0xf) + ((10 - pos.row_ch()) & 0xf) * 10
	);
}

void Nano_Chess::move(const Move& move) {
	origin_of_move = ch_from_position(move.from);
	target_of_move = ch_from_position(move.to);
	if (move.promoted != Piece::none) {
		promote_to = static_cast<char>(move.promoted);
	} else {
		promote_to = static_cast<char>(board[static_cast<unsigned char>(origin_of_move)] & 0xf);
	}
	put_string("\nperform move ");
	print_position(origin_of_move);
	print_position(target_of_move);
	put_char(' ');
	put_char(static_cast<char>(move.piece));

	if (move.promoted != Piece::none) {
		put_string(" !");
		put_char(static_cast<char>(move.promoted));
	}

	if (move.captured != Piece::none) {
		put_string(" x");
		put_char(static_cast<char>(move.captured));
		if (move.captured_position != move.to) {
			print_position(ch_from_position(move.captured_position));
		}
	}
	put_char('\n');
	next(0, 0, 0, 21, can_en_passant, 1);
	print_board();
}

Position position_from_ch(char ch) {
	return Position { ch % 10, 10 - ch / 10 };
}

Piece piece_on_board(const Position& pos) {
	return piece_from_ch(piece_letters[
		board[static_cast<unsigned char>(ch_from_position(pos))] & 0xf
	]);
}

bool is_en_passant(const Position& from, const Position& to) {
	if (piece_on_board(from) != Piece::pawn) { return false; }
	if (from.col == to.col) { return false; }
	return piece_on_board(to) == Piece::none;
}

bool is_capture(const Position& from, const Position& to) {
	return piece_on_board(to) != Piece::none || is_en_passant(from, to);
}

Move Nano_Chess::compute_move() {
	put_string("\nperform computer move\n");
	next(0, 0, 0, 21, can_en_passant, MAX_LEVEL);
	auto origin { position_from_ch(origin_of_move) };
	auto target { position_from_ch(target_of_move) };
	if (is_capture(origin, target)) {
		if (is_en_passant(origin, target)) {
			Position capture_pos { target.col, origin.row };
			return Move {
				origin, target, piece_on_board(origin), piece_from_ch(promote_to),
				piece_on_board(capture_pos), capture_pos
			};
		} else {
			return Move {
				origin, target, piece_on_board(origin), piece_from_ch(promote_to),
				piece_on_board(target), target
			};
		}
	} else {
		return Move {
			origin, target, piece_on_board(origin), piece_from_ch(promote_to)
		};
	}
}
```

## src/nano-chess.h
```c
#if !defined(Nano_Chess_h)
#define Nano_Chess_h

	#include "chess-interface.h"

	void put_string(const char* s);

	namespace Mek::Chess {
		class Nano_Chess : public Engine {
			public:
				void reset_board() override;
				void move(const Move& move) override;
				Move compute_move() override;
		};
	}

#endif
```
